## drivers/misc/mediatek/sensors-1.0/accelerometer/mir3da/Kconfig
```kconfig
config MTK_MIR3DA
	bool "mir3da for MediaTek package"
	default n
	help
	  It support different accelerometer sensor.
          If this option is set,
	  it will support
          mir3da Accelerometer.
```

## drivers/misc/mediatek/sensors-1.0/alsps/ltr578/Kconfig
```kconfig
config MTK_LTR578
	bool "MTK_LTR578 for MediaTek package"
	default n
	help
	It support different type sensor
	in this platform. If this option
	is set, it will support ambient
	and light sensor MTK_LTR578.
```

## drivers/misc/mediatek/sensors-1.0/magnetometer/af9133/Kconfig
```kconfig
config MTK_AF9133
	bool "AF9133 for MediaTek package"
	default n
	help
	  It support different magnetometer sensor.
          If this option is set,
	  it will support
          AF9133 magnetometer.
```

## tinno/common_features/Kconfig
```kconfig
menuconfig TINNO
	bool "tinno kernel code"
	help
	  You can build and test tinno kernel code here.

config TINNO_PERSO_SENSORS
    bool "sensor control for perso"
    default n
    help
	  control the sensor from misc partition

# product info.
config TINNO_PRODUCT_INFO
    bool "TINNO_PRODUCT_INFO"
    default n
```
